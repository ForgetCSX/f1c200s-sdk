## package/custom_io_ext/Config.in
```kconfig
config BR2_PACKAGE_CUSTOM_IO_EXT
    bool "Custom IO Extension Device"
    select BR2_PACKAGE_LINUX_MODULES

choice
    prompt "Build as"
    depends on BR2_PACKAGE_CUSTOM_IO_EXT
    default BR2_CUSTOM_IO_EXT_BUILTIN

config BR2_CUSTOM_IO_EXT_BUILTIN
    bool "Built into kernel"

config BR2_CUSTOM_IO_EXT_MODULE
    bool "Build as module (.ko)"
    
endchoice
```
